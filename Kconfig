## Kconfig
```kconfig
config OFFSETKEY_MOUSE_WHEEL_TICK
    bool "OffsetKey one-shot mouse wheel behavior"
    depends on ZMK_POINTING
    default y
    help
      Sends a discrete HID mouse wheel report for each behavior press.
```

## dts/bindings/behaviors/offsetkey,behavior-mouse-wheel-tick.yaml
```yaml
# Copyright (c) 2026
# SPDX-License-Identifier: MIT

description: One-shot mouse wheel behavior for encoder ticks

compatible: "offsetkey,behavior-mouse-wheel-tick"

include: two_param.yaml

properties:
  acceleration-threshold-ms:
    type: int
    default: 80
    description: |
      Consecutive ticks within this interval increase the acceleration level.
      Set to 0 to disable acceleration.

  acceleration-max:
    type: int
    default: 4
    description: Maximum multiplier applied to fast consecutive wheel ticks.
```
